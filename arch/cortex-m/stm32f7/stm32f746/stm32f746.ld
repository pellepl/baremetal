MEMORY
{
  FLASH (rx)	: ORIGIN = 0x08000000, LENGTH = 1024K
  RAM (xrw)     : ORIGIN = 0x20000000, LENGTH = 320K
  CCMRAM (xrw)	: ORIGIN = 0x10000000, LENGTH = 64K
}

INCLUDE "arch/cortex-m/stm32f7/stm32f7.ld"
